## Kconfig.memlease
```kconfig
menuconfig MEMLEASE
	bool "Memlease"
	default y
	help
	  Lease-based heap memory management. Buffers are allocated from the
	  system heap (k_malloc), so CONFIG_HEAP_MEM_POOL_SIZE must be > 0.

if MEMLEASE

config MEMLEASE_NUM_ENTRIES_PER_BUF
	int "Number of entries per buffer"
	default 32
	range 1 65535
	help
	  Number of allocation tracking entries stored in a single entry block.
	  The first block is statically allocated, further blocks are allocated
	  on the heap when needed.

config MEMLEASE_THREAD_STACK_SIZE
	int "Memlease thread stack size"
	default 1024

config MEMLEASE_THREAD_PRIORITY
	int "Memlease thread priority"
	default 7
	help
	  Priority of the thread that frees expired leases and calls the
	  expiry callbacks.

config MEMLEASE_DEBUG_INFO
	bool "Record allocation site and time"
	help
	  Store the file, line and uptime of every memlease_alloc() call, so
	  memlease_foreach(), memlease_dump() and the shell command can show
	  where each lease was allocated. Costs 16 bytes per entry.

config MEMLEASE_SHELL
	bool "Memlease shell commands"
	depends on SHELL
	help
	  Adds the "memlease list" and "memlease stats" shell commands.

module = MEMLEASE
module-str = Memlease
source "subsys/logging/Kconfig.template.log_config"

endif # MEMLEASE
```

## tests/memlease_test/testcase.yaml
```yaml
common:
  platform_allow: nrf52840dk/nrf52840
  tags: memlease
  harness: ztest
  timeout: 300
tests:
  memlease.test: {}
  memlease.test.default_config:
    extra_configs:
      - CONFIG_MEMLEASE_NUM_ENTRIES_PER_BUF=32
      - CONFIG_MEMLEASE_DEBUG_INFO=n
  memlease.test.shell:
    build_only: true
    extra_configs:
      - CONFIG_SHELL=y
      - CONFIG_MEMLEASE_SHELL=y
```
